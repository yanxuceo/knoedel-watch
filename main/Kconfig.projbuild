## main/Kconfig.projbuild
```kconfig
menu "Knödel Watch"

choice KNOEDEL_BOARD
    prompt "Target board"
    default KNOEDEL_BOARD_M5_STOPWATCH
    help
        The board the firmware is built for. Each board implements
        main/board/board.h in a file of its own.

config KNOEDEL_BOARD_M5_STOPWATCH
    bool "M5Stack StopWatch Dev Kit"

config KNOEDEL_BOARD_WAVESHARE_175C
    bool "Waveshare ESP32-S3-Touch-AMOLED-1.75C"

endchoice

config KNOEDEL_MIC_TEST
    bool "Microphone test: hold the right key to record"
    default n
    help
        For trying the microphone: holding the right key records up to 30 s,
        which then goes out over USB to tools/mic_test.py on the computer.
        Not for a release.

endmenu
```

## sdkconfig.defaults.waveshare_175c
```kconfig
CONFIG_KNOEDEL_BOARD_WAVESHARE_175C=y
# CONFIG_KNOEDEL_BOARD_M5_STOPWATCH is not set
CONFIG_ESPTOOLPY_FLASHSIZE_32MB=y
```
